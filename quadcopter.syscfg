/**
 * @cliArgs --board "/ti/boards/MSP_EXP432P401R" --product "simplelink_msp432p4_sdk@3.40.01.02"
 * @versions {"data":"2020021217","timestamp":"2020021217","tool":"1.4.0+1234","templates":"2020021217"}
 */

/**
 * Import the modules used in this configuration.
 */
const DriverLib = scripting.addModule("/ti/devices/DriverLib");
const Board     = scripting.addModule("/ti/drivers/Board");
const I2C       = scripting.addModule("/ti/drivers/I2C");
const I2C1      = I2C.addInstance();
const PWM       = scripting.addModule("/ti/drivers/PWM", {}, false);
const PWM1      = PWM.addInstance();
const PWM2      = PWM.addInstance();
const PWM3      = PWM.addInstance();
const PWM4      = PWM.addInstance();
const Power     = scripting.addModule("/ti/drivers/Power");
const RTOS      = scripting.addModule("/ti/drivers/RTOS");
const Timer     = scripting.addModule("/ti/drivers/Timer", {}, false);
const Timer1    = Timer.addInstance();
const UART      = scripting.addModule("/ti/drivers/UART");
const UART1     = UART.addInstance();
const UART2     = UART.addInstance();

/**
 * Write custom configuration values to the imported modules.
 */
I2C1.$name              = "CONFIG_I2C_0";
I2C1.i2c.$name          = "MyI2C1";
I2C1.i2c.$assign        = "EUSCI_B1";
I2C1.i2c.sdaPin.$assign = "boosterpack.10";
I2C1.i2c.sclPin.$assign = "boosterpack.9";

PWM1.$name                = "CONFIG_PWM_0";
PWM1.timer.$name          = "MyTIMER_A1";
PWM1.timer.$assign        = "Timer_A0";
PWM1.timer.pwmPin.$assign = "boosterpack.38";

PWM2.$name                = "CONFIG_PWM_1";
PWM2.timer.$name          = "MyTIMER_A1";
PWM2.timer.$assign        = "Timer_A0";
PWM2.timer.pwmPin.$assign = "boosterpack.19";

PWM3.$name                = "CONFIG_PWM_2";
PWM3.timer.$name          = "MyTIMER_A1";
PWM3.timer.$assign        = "Timer_A0";
PWM3.timer.pwmPin.$assign = "boosterpack.39";

PWM4.$name                = "CONFIG_PWM_3";
PWM4.timer.$name          = "MyTIMER_A1";
PWM4.timer.$assign        = "Timer_A0";
PWM4.timer.pwmPin.$assign = "boosterpack.40";

Power.performanceLevel3.$name = "ti_drivers_power_PowerMSP432PerfLevels0";
Power.performanceLevel2.$name = "ti_drivers_power_PowerMSP432PerfLevels1";
Power.performanceLevel1.$name = "ti_drivers_power_PowerMSP432PerfLevels2";
Power.performanceLevel0.$name = "ti_drivers_power_PowerMSP432PerfLevels3";

RTOS.name = "FreeRTOS";

Timer1.$name         = "CONFIG_TIMER_0";
Timer1.timerType     = "32 Bits";
Timer1.timer.$name   = "MyTIMER321";
Timer1.timer.$assign = "TIMER32_0";

UART1.$name      = "CONFIG_UART_0";
UART1.$hardware  = system.deviceData.board.components.XDS110UART;
UART1.baudRates  = [9600,115200];
UART1.uart.$name = "MyUART1";

UART2.$name              = "CONFIG_UART_1";
UART2.baudRates          = [9600,115200];
UART2.uart.$name         = "MyUART1";
UART2.uart.$assign       = "EUSCI_A2";
UART2.uart.txPin.$assign = "boosterpack.4";
UART2.uart.rxPin.$assign = "boosterpack.3";

/**
 * Pinmux solution for unlocked pins/peripherals. This ensures that minor changes to the automatic solver in a future
 * version of the tool will not impact the pinmux you originally saw.  These lines can be completely deleted in order to
 * re-solve from scratch.
 */
UART1.uart.$suggestSolution       = "EUSCI_A0";
UART1.uart.txPin.$suggestSolution = "7";
UART1.uart.rxPin.$suggestSolution = "6";
